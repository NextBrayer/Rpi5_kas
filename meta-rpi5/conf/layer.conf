## meta-rpi5/conf/layer.conf
```bitbake
BBPATH .= ":${LAYERDIR}"
BBFILES += "${LAYERDIR}/recipes-*/*/*.bb ${LAYERDIR}/recipes-*/*/*.bbappend"

BBFILE_COLLECTIONS += "rpi5"
BBFILE_PATTERN_rpi5 = "^${LAYERDIR}/"
BBFILE_PRIORITY_rpi5 = "10"

LAYERDEPENDS_rpi5 = "core raspberrypi"
LAYERSERIES_COMPAT_rpi5 = "wrynose"
```
